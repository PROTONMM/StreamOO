## main/Kconfig.projbuild
```kconfig
menu "StreamOO Configuration"
    config STREAMOO_ENCODER_GESTURE_TEST
        bool "Diagnostic encoder GPIO and gesture probe"
        default y
        help
            Capture both edges of A/B/button with GPIO interrupts and a bounded
            queue. Log IRQ counts once per second and decoded TEST gestures.
            Overflow resets the decoder and is reported. Emits gestures only;
            the interactive UI TEST option maps them to test commands.
    config STREAMOO_ENCODER_UI_TEST
        bool "Interactive encoder UI TEST instead of finite OLED sequence"
        depends on STREAMOO_ENCODER_GESTURE_TEST && STREAMOO_LCD_SMOKE_TEST
        default y
        help
            Start interactive HOME immediately and keep rendering until reset.
            Synthetic catalog and visualization. Continuous audio control TEST
            optionally connects VOL/PLAY to a test tone; otherwise UI-only.
            No network. Volume/widget saved to NVS after 5 seconds idle.
            Disable for the finite OLED diagnostic.
    config STREAMOO_RESERVE_USB
        bool "Reserve GPIO19/20 for USB debugging"
        default y
        help
            Disable only when USB is disconnected and is not used for console,
            USB devices or JTAG. Flash/PSRAM and strapping pins are always rejected.
    menu "Hardware: SSD1322"
        config STREAMOO_LCD_SMOKE_TEST
            bool "Run finite SSD1322 diagnostic at startup"
            default y
            help
                With interactive encoder UI TEST enabled, show interactive HOME.
                Otherwise: black, white, grayscale, inverse, geometry and Polish text,
                then 20 seconds of full HOME snapshots with synthetic network,
                clock and audio data, followed by 8 seconds of station-list
                navigation. Display off
                after approximately 46 seconds. No player or real station catalog.
                User module is configured with R5/R8: BS1=0 and BS0=0.
                Cold power-on/reset must be provided by the board if RESET=-1.
        config STREAMOO_LCD_COLUMN_OFFSET
            int "Experimental panel column offset (four-pixel units)"
            range 0 56
            default 28
            help
                Centered 256-pixel window in 480-pixel controller RAM.
                Must be verified against the image on the actual panel.
        config STREAMOO_LCD_REMAP
            int "Experimental A0 remap byte (decimal)"
            range 0 22
            default 20
            help
                20 = 0x14: nibble remap and reversed COM scan. Only bits
                1, 2 and 4 are accepted. Dual COM and horizontal increment
                are fixed for this 256x64 test profile. Verify orientation.
        config STREAMOO_LCD_SPI_HOST
            int "SPI host (2=SPI2, 3=SPI3)"
            range 2 3
            default 2
        config STREAMOO_LCD_MOSI
            int "MOSI GPIO"
            range 0 48
            default 11
        config STREAMOO_LCD_SCLK
            int "SCLK GPIO"
            range 0 48
            default 12
        config STREAMOO_LCD_CS
            int "CS GPIO"
            range 0 48
            default 9
        config STREAMOO_LCD_DC
            int "DC GPIO"
            range 0 48
            default 10
        config STREAMOO_LCD_RST
            int "RESET GPIO (-1 for no GPIO-controlled reset)"
            range -1 48
            default -1
        config STREAMOO_LCD_SPI_CLOCK_MHZ
            int "SPI clock (MHz)"
            range 1 10
            default 10
    endmenu
    menu "Hardware: PCM5102A (I2S)"
        config STREAMOO_AUDIO_CONTROL_TEST
            bool "Continuous tone controlled by encoder VOL/PLAY TEST"
            depends on STREAMOO_ENCODER_UI_TEST
            default y
            select I2S_ISR_IRAM_SAFE
            help
                Starts in STOP with restored volume. PLAY sends a continuous
                stereo 1kHz test tone, source peak -30dBFS before volume gain.
                50ms gain ramps. Overrides the finite I2S smoke sequence.
                Widgets remain synthetic. Not a network stream player.
        config STREAMOO_MP3_FIXTURE_TEST
            bool "Decode embedded MP3 file to PSRAM and play TEST clip"
            depends on STREAMOO_AUDIO_CONTROL_TEST
            default y
            help
                Use original L/R 48kHz MP3 fixture instead of continuous sine.
                Decode once at startup outside I2S, then loop the PCM in PSRAM.
                No network streaming or resampling. Initial STOP, real VOL/PLAY.
        config STREAMOO_PCM_STALL_TEST
            bool "TEST: pause PCM producer 400ms once after first PLAY"
            depends on STREAMOO_AUDIO_CONTROL_TEST
            default n
            help
                Three seconds after first PLAY, starve the PCM FIFO deliberately.
                Exercise reserve fade, buffering and smooth recovery.
        config STREAMOO_PCM_TAP_DELAY_MS
            int "TEST: extra delay of pre-gain PCM tap consumer (ms)"
            depends on STREAMOO_AUDIO_CONTROL_TEST
            range 0 1000
            default 0
            help
                0 processes every RTOS tick. Larger values force tap drops;
                analysis must never block the PCM audio consumer.
        config STREAMOO_I2S_SMOKE_TEST
            bool "Run finite left/right I2S tone TEST at startup"
            default y
            select I2S_ISR_IRAM_SAFE
            help
                Ignored while continuous audio control TEST is enabled.
                About 10 seconds: silence, left 1kHz, right 2kHz, both 1kHz.
                Fixed approximately -30dBFS peak, independent of UI volume.
                48kHz/32-bit Philips I2S, no MCLK. Requires DAC configured
                for I2S and unmuted. Not a stream player or audio pipeline.
        config STREAMOO_I2S_DOUT
            int "I2S DATA OUT GPIO"
            range 0 48
            default 48
        config STREAMOO_I2S_BCLK
            int "I2S BCLK GPIO"
            range 0 48
            default 47
        config STREAMOO_I2S_LRCLK
            int "I2S LRCLK GPIO"
            range 0 48
            default 21
    endmenu
    menu "Hardware: Encoder"
        config STREAMOO_ENCODER_GPIO_A
            int "Encoder A GPIO"
            range 0 48
            default 5
        config STREAMOO_ENCODER_GPIO_B
            int "Encoder B GPIO"
            range 0 48
            default 6
        config STREAMOO_ENCODER_GPIO_BUTTON
            int "Encoder button GPIO"
            range 0 48
            default 7
        config STREAMOO_ENCODER_INTERNAL_PULLUP
            bool "Enable internal pull-ups"
            default n
        config STREAMOO_ENCODER_REVERSED
            bool "Invert encoder direction"
            default y
        config STREAMOO_ENCODER_HALF_QUADRATURE
            bool "Use half-quadrature detents"
            default y
        choice STREAMOO_ENCODER_MODE
            prompt "Encoder interaction mode"
            default STREAMOO_ENCODER_MODE_A
            config STREAMOO_ENCODER_MODE_A
                bool "Mode A: short=stations, long=play/stop"
            config STREAMOO_ENCODER_MODE_B
                bool "Mode B: short=play/stop, long=stations"
        endchoice
    endmenu
    menu "Audio and DSP"
        config STREAMOO_STREAM_BUFFER_KIB
            int "Compressed stream ring size (KiB)"
            range 64 2048
            default 256
        choice STREAMOO_FFT_SIZE
            prompt "FFT size"
            default STREAMOO_FFT_1024
            config STREAMOO_FFT_1024
                bool "1024"
            config STREAMOO_FFT_2048
                bool "2048"
        endchoice
        config STREAMOO_DSP_ENABLE_SIMD
            bool "Prefer optimized ESP32-S3 DSP routines"
            default y
    endmenu
endmenu
```
